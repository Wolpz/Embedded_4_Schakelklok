;
; File Name: cyfitterrv.inc
; 
; PSoC Creator  4.4
;
; Description:
; 
;
;-------------------------------------------------------------------------------
; Copyright (c) 2007-2020 Cypress Semiconductor.  All rights reserved.
; You may use this file only in accordance with the license, terms, conditions, 
; disclaimers, and limitations in the end user license agreement accompanying 
; the software package with which this file was provided.
;-------------------------------------------------------------------------------

    IF :LNOT::DEF:INCLUDED_CYFITTERRV_INC
INCLUDED_CYFITTERRV_INC EQU 1
    GET cydevicerv.inc
    GET cydevicerv_trm.inc

; io_RTC
io_RTC__0__INTTYPE EQU CYREG_PICU3_INTTYPE4
io_RTC__0__MASK EQU 0x10
io_RTC__0__PC EQU CYREG_PRT3_PC4
io_RTC__0__PORT EQU 3
io_RTC__0__SHIFT EQU 4
io_RTC__1__INTTYPE EQU CYREG_PICU3_INTTYPE5
io_RTC__1__MASK EQU 0x20
io_RTC__1__PC EQU CYREG_PRT3_PC5
io_RTC__1__PORT EQU 3
io_RTC__1__SHIFT EQU 5
io_RTC__2__INTTYPE EQU CYREG_PICU3_INTTYPE6
io_RTC__2__MASK EQU 0x40
io_RTC__2__PC EQU CYREG_PRT3_PC6
io_RTC__2__PORT EQU 3
io_RTC__2__SHIFT EQU 6
io_RTC__3__INTTYPE EQU CYREG_PICU3_INTTYPE7
io_RTC__3__MASK EQU 0x80
io_RTC__3__PC EQU CYREG_PRT3_PC7
io_RTC__3__PORT EQU 3
io_RTC__3__SHIFT EQU 7
io_RTC__AG EQU CYREG_PRT3_AG
io_RTC__AMUX EQU CYREG_PRT3_AMUX
io_RTC__BIE EQU CYREG_PRT3_BIE
io_RTC__BIT_MASK EQU CYREG_PRT3_BIT_MASK
io_RTC__BYP EQU CYREG_PRT3_BYP
io_RTC__CTL EQU CYREG_PRT3_CTL
io_RTC__DM0 EQU CYREG_PRT3_DM0
io_RTC__DM1 EQU CYREG_PRT3_DM1
io_RTC__DM2 EQU CYREG_PRT3_DM2
io_RTC__DR EQU CYREG_PRT3_DR
io_RTC__INP_DIS EQU CYREG_PRT3_INP_DIS
io_RTC__INT__INTTYPE EQU CYREG_PICU3_INTTYPE5
io_RTC__INT__MASK EQU 0x20
io_RTC__INT__PC EQU CYREG_PRT3_PC5
io_RTC__INT__PORT EQU 3
io_RTC__INT__SHIFT EQU 5
io_RTC__INTTYPE_BASE EQU CYDEV_PICU_INTTYPE_PICU3_BASE
io_RTC__LCD_COM_SEG EQU CYREG_PRT3_LCD_COM_SEG
io_RTC__LCD_EN EQU CYREG_PRT3_LCD_EN
io_RTC__MASK EQU 0xF0
io_RTC__PORT EQU 3
io_RTC__PRT EQU CYREG_PRT3_PRT
io_RTC__PRTDSI__CAPS_SEL EQU CYREG_PRT3_CAPS_SEL
io_RTC__PRTDSI__DBL_SYNC_IN EQU CYREG_PRT3_DBL_SYNC_IN
io_RTC__PRTDSI__OE_SEL0 EQU CYREG_PRT3_OE_SEL0
io_RTC__PRTDSI__OE_SEL1 EQU CYREG_PRT3_OE_SEL1
io_RTC__PRTDSI__OUT_SEL0 EQU CYREG_PRT3_OUT_SEL0
io_RTC__PRTDSI__OUT_SEL1 EQU CYREG_PRT3_OUT_SEL1
io_RTC__PRTDSI__SYNC_OUT EQU CYREG_PRT3_SYNC_OUT
io_RTC__PS EQU CYREG_PRT3_PS
io_RTC__RST__INTTYPE EQU CYREG_PICU3_INTTYPE4
io_RTC__RST__MASK EQU 0x10
io_RTC__RST__PC EQU CYREG_PRT3_PC4
io_RTC__RST__PORT EQU 3
io_RTC__RST__SHIFT EQU 4
io_RTC__SCL__INTTYPE EQU CYREG_PICU3_INTTYPE7
io_RTC__SCL__MASK EQU 0x80
io_RTC__SCL__PC EQU CYREG_PRT3_PC7
io_RTC__SCL__PORT EQU 3
io_RTC__SCL__SHIFT EQU 7
io_RTC__SDA__INTTYPE EQU CYREG_PICU3_INTTYPE6
io_RTC__SDA__MASK EQU 0x40
io_RTC__SDA__PC EQU CYREG_PRT3_PC6
io_RTC__SDA__PORT EQU 3
io_RTC__SDA__SHIFT EQU 6
io_RTC__SHIFT EQU 4
io_RTC__SLW EQU CYREG_PRT3_SLW

; Clock_1
Clock_1__CFG0 EQU CYREG_CLKDIST_DCFG0_CFG0
Clock_1__CFG1 EQU CYREG_CLKDIST_DCFG0_CFG1
Clock_1__CFG2 EQU CYREG_CLKDIST_DCFG0_CFG2
Clock_1__CFG2_SRC_SEL_MASK EQU 0x07
Clock_1__INDEX EQU 0x00
Clock_1__PM_ACT_CFG EQU CYREG_PM_ACT_CFG2
Clock_1__PM_ACT_MSK EQU 0x01
Clock_1__PM_STBY_CFG EQU CYREG_PM_STBY_CFG2
Clock_1__PM_STBY_MSK EQU 0x01

; ISR_1kHz
ISR_1kHz__INTC_CLR_EN_REG EQU CYREG_NVIC_CLRENA0
ISR_1kHz__INTC_CLR_PD_REG EQU CYREG_NVIC_CLRPEND0
ISR_1kHz__INTC_MASK EQU 0x01
ISR_1kHz__INTC_NUMBER EQU 0
ISR_1kHz__INTC_PRIOR_NUM EQU 7
ISR_1kHz__INTC_PRIOR_REG EQU CYREG_NVIC_PRI_0
ISR_1kHz__INTC_SET_EN_REG EQU CYREG_NVIC_SETENA0
ISR_1kHz__INTC_SET_PD_REG EQU CYREG_NVIC_SETPEND0

; i_Button
i_Button__0__INTTYPE EQU CYREG_PICU0_INTTYPE4
i_Button__0__MASK EQU 0x10
i_Button__0__PC EQU CYREG_PRT0_PC4
i_Button__0__PORT EQU 0
i_Button__0__SHIFT EQU 4
i_Button__1__INTTYPE EQU CYREG_PICU0_INTTYPE5
i_Button__1__MASK EQU 0x20
i_Button__1__PC EQU CYREG_PRT0_PC5
i_Button__1__PORT EQU 0
i_Button__1__SHIFT EQU 5
i_Button__2__INTTYPE EQU CYREG_PICU0_INTTYPE6
i_Button__2__MASK EQU 0x40
i_Button__2__PC EQU CYREG_PRT0_PC6
i_Button__2__PORT EQU 0
i_Button__2__SHIFT EQU 6
i_Button__3__INTTYPE EQU CYREG_PICU0_INTTYPE7
i_Button__3__MASK EQU 0x80
i_Button__3__PC EQU CYREG_PRT0_PC7
i_Button__3__PORT EQU 0
i_Button__3__SHIFT EQU 7
i_Button__AG EQU CYREG_PRT0_AG
i_Button__AMUX EQU CYREG_PRT0_AMUX
i_Button__Back__INTTYPE EQU CYREG_PICU0_INTTYPE6
i_Button__Back__MASK EQU 0x40
i_Button__Back__PC EQU CYREG_PRT0_PC6
i_Button__Back__PORT EQU 0
i_Button__Back__SHIFT EQU 6
i_Button__BIE EQU CYREG_PRT0_BIE
i_Button__BIT_MASK EQU CYREG_PRT0_BIT_MASK
i_Button__BYP EQU CYREG_PRT0_BYP
i_Button__CTL EQU CYREG_PRT0_CTL
i_Button__DM0 EQU CYREG_PRT0_DM0
i_Button__DM1 EQU CYREG_PRT0_DM1
i_Button__DM2 EQU CYREG_PRT0_DM2
i_Button__Down__INTTYPE EQU CYREG_PICU0_INTTYPE5
i_Button__Down__MASK EQU 0x20
i_Button__Down__PC EQU CYREG_PRT0_PC5
i_Button__Down__PORT EQU 0
i_Button__Down__SHIFT EQU 5
i_Button__DR EQU CYREG_PRT0_DR
i_Button__INP_DIS EQU CYREG_PRT0_INP_DIS
i_Button__INTTYPE_BASE EQU CYDEV_PICU_INTTYPE_PICU0_BASE
i_Button__LCD_COM_SEG EQU CYREG_PRT0_LCD_COM_SEG
i_Button__LCD_EN EQU CYREG_PRT0_LCD_EN
i_Button__MASK EQU 0xF0
i_Button__OK__INTTYPE EQU CYREG_PICU0_INTTYPE7
i_Button__OK__MASK EQU 0x80
i_Button__OK__PC EQU CYREG_PRT0_PC7
i_Button__OK__PORT EQU 0
i_Button__OK__SHIFT EQU 7
i_Button__PORT EQU 0
i_Button__PRT EQU CYREG_PRT0_PRT
i_Button__PRTDSI__CAPS_SEL EQU CYREG_PRT0_CAPS_SEL
i_Button__PRTDSI__DBL_SYNC_IN EQU CYREG_PRT0_DBL_SYNC_IN
i_Button__PRTDSI__OE_SEL0 EQU CYREG_PRT0_OE_SEL0
i_Button__PRTDSI__OE_SEL1 EQU CYREG_PRT0_OE_SEL1
i_Button__PRTDSI__OUT_SEL0 EQU CYREG_PRT0_OUT_SEL0
i_Button__PRTDSI__OUT_SEL1 EQU CYREG_PRT0_OUT_SEL1
i_Button__PRTDSI__SYNC_OUT EQU CYREG_PRT0_SYNC_OUT
i_Button__PS EQU CYREG_PRT0_PS
i_Button__SHIFT EQU 4
i_Button__SLW EQU CYREG_PRT0_SLW
i_Button__Up__INTTYPE EQU CYREG_PICU0_INTTYPE4
i_Button__Up__MASK EQU 0x10
i_Button__Up__PC EQU CYREG_PRT0_PC4
i_Button__Up__PORT EQU 0
i_Button__Up__SHIFT EQU 4

; o_Display
o_Display__0__INTTYPE EQU CYREG_PICU2_INTTYPE0
o_Display__0__MASK EQU 0x01
o_Display__0__PC EQU CYREG_PRT2_PC0
o_Display__0__PORT EQU 2
o_Display__0__SHIFT EQU 0
o_Display__1__INTTYPE EQU CYREG_PICU2_INTTYPE1
o_Display__1__MASK EQU 0x02
o_Display__1__PC EQU CYREG_PRT2_PC1
o_Display__1__PORT EQU 2
o_Display__1__SHIFT EQU 1
o_Display__2__INTTYPE EQU CYREG_PICU2_INTTYPE2
o_Display__2__MASK EQU 0x04
o_Display__2__PC EQU CYREG_PRT2_PC2
o_Display__2__PORT EQU 2
o_Display__2__SHIFT EQU 2
o_Display__3__INTTYPE EQU CYREG_PICU2_INTTYPE3
o_Display__3__MASK EQU 0x08
o_Display__3__PC EQU CYREG_PRT2_PC3
o_Display__3__PORT EQU 2
o_Display__3__SHIFT EQU 3
o_Display__4__INTTYPE EQU CYREG_PICU2_INTTYPE4
o_Display__4__MASK EQU 0x10
o_Display__4__PC EQU CYREG_PRT2_PC4
o_Display__4__PORT EQU 2
o_Display__4__SHIFT EQU 4
o_Display__AG EQU CYREG_PRT2_AG
o_Display__AMUX EQU CYREG_PRT2_AMUX
o_Display__BIE EQU CYREG_PRT2_BIE
o_Display__BIT_MASK EQU CYREG_PRT2_BIT_MASK
o_Display__BYP EQU CYREG_PRT2_BYP
o_Display__CS__INTTYPE EQU CYREG_PICU2_INTTYPE2
o_Display__CS__MASK EQU 0x04
o_Display__CS__PC EQU CYREG_PRT2_PC2
o_Display__CS__PORT EQU 2
o_Display__CS__SHIFT EQU 2
o_Display__CTL EQU CYREG_PRT2_CTL
o_Display__DC__INTTYPE EQU CYREG_PICU2_INTTYPE1
o_Display__DC__MASK EQU 0x02
o_Display__DC__PC EQU CYREG_PRT2_PC1
o_Display__DC__PORT EQU 2
o_Display__DC__SHIFT EQU 1
o_Display__DM0 EQU CYREG_PRT2_DM0
o_Display__DM1 EQU CYREG_PRT2_DM1
o_Display__DM2 EQU CYREG_PRT2_DM2
o_Display__DR EQU CYREG_PRT2_DR
o_Display__INP_DIS EQU CYREG_PRT2_INP_DIS
o_Display__INTTYPE_BASE EQU CYDEV_PICU_INTTYPE_PICU2_BASE
o_Display__LCD_COM_SEG EQU CYREG_PRT2_LCD_COM_SEG
o_Display__LCD_EN EQU CYREG_PRT2_LCD_EN
o_Display__MASK EQU 0x1F
o_Display__MOSI__INTTYPE EQU CYREG_PICU2_INTTYPE4
o_Display__MOSI__MASK EQU 0x10
o_Display__MOSI__PC EQU CYREG_PRT2_PC4
o_Display__MOSI__PORT EQU 2
o_Display__MOSI__SHIFT EQU 4
o_Display__PORT EQU 2
o_Display__PRT EQU CYREG_PRT2_PRT
o_Display__PRTDSI__CAPS_SEL EQU CYREG_PRT2_CAPS_SEL
o_Display__PRTDSI__DBL_SYNC_IN EQU CYREG_PRT2_DBL_SYNC_IN
o_Display__PRTDSI__OE_SEL0 EQU CYREG_PRT2_OE_SEL0
o_Display__PRTDSI__OE_SEL1 EQU CYREG_PRT2_OE_SEL1
o_Display__PRTDSI__OUT_SEL0 EQU CYREG_PRT2_OUT_SEL0
o_Display__PRTDSI__OUT_SEL1 EQU CYREG_PRT2_OUT_SEL1
o_Display__PRTDSI__SYNC_OUT EQU CYREG_PRT2_SYNC_OUT
o_Display__PS EQU CYREG_PRT2_PS
o_Display__RST__INTTYPE EQU CYREG_PICU2_INTTYPE0
o_Display__RST__MASK EQU 0x01
o_Display__RST__PC EQU CYREG_PRT2_PC0
o_Display__RST__PORT EQU 2
o_Display__RST__SHIFT EQU 0
o_Display__SCLK__INTTYPE EQU CYREG_PICU2_INTTYPE3
o_Display__SCLK__MASK EQU 0x08
o_Display__SCLK__PC EQU CYREG_PRT2_PC3
o_Display__SCLK__PORT EQU 2
o_Display__SCLK__SHIFT EQU 3
o_Display__SHIFT EQU 0
o_Display__SLW EQU CYREG_PRT2_SLW

; o_DebugLed
o_DebugLed__0__INTTYPE EQU CYREG_PICU1_INTTYPE4
o_DebugLed__0__MASK EQU 0x10
o_DebugLed__0__PC EQU CYREG_PRT1_PC4
o_DebugLed__0__PORT EQU 1
o_DebugLed__0__SHIFT EQU 4
o_DebugLed__1__INTTYPE EQU CYREG_PICU1_INTTYPE5
o_DebugLed__1__MASK EQU 0x20
o_DebugLed__1__PC EQU CYREG_PRT1_PC5
o_DebugLed__1__PORT EQU 1
o_DebugLed__1__SHIFT EQU 5
o_DebugLed__2__INTTYPE EQU CYREG_PICU1_INTTYPE6
o_DebugLed__2__MASK EQU 0x40
o_DebugLed__2__PC EQU CYREG_PRT1_PC6
o_DebugLed__2__PORT EQU 1
o_DebugLed__2__SHIFT EQU 6
o_DebugLed__AG EQU CYREG_PRT1_AG
o_DebugLed__AMUX EQU CYREG_PRT1_AMUX
o_DebugLed__BIE EQU CYREG_PRT1_BIE
o_DebugLed__BIT_MASK EQU CYREG_PRT1_BIT_MASK
o_DebugLed__Blu__INTTYPE EQU CYREG_PICU1_INTTYPE5
o_DebugLed__Blu__MASK EQU 0x20
o_DebugLed__Blu__PC EQU CYREG_PRT1_PC5
o_DebugLed__Blu__PORT EQU 1
o_DebugLed__Blu__SHIFT EQU 5
o_DebugLed__BYP EQU CYREG_PRT1_BYP
o_DebugLed__CTL EQU CYREG_PRT1_CTL
o_DebugLed__DM0 EQU CYREG_PRT1_DM0
o_DebugLed__DM1 EQU CYREG_PRT1_DM1
o_DebugLed__DM2 EQU CYREG_PRT1_DM2
o_DebugLed__DR EQU CYREG_PRT1_DR
o_DebugLed__Grn__INTTYPE EQU CYREG_PICU1_INTTYPE6
o_DebugLed__Grn__MASK EQU 0x40
o_DebugLed__Grn__PC EQU CYREG_PRT1_PC6
o_DebugLed__Grn__PORT EQU 1
o_DebugLed__Grn__SHIFT EQU 6
o_DebugLed__INP_DIS EQU CYREG_PRT1_INP_DIS
o_DebugLed__INTTYPE_BASE EQU CYDEV_PICU_INTTYPE_PICU1_BASE
o_DebugLed__LCD_COM_SEG EQU CYREG_PRT1_LCD_COM_SEG
o_DebugLed__LCD_EN EQU CYREG_PRT1_LCD_EN
o_DebugLed__MASK EQU 0x70
o_DebugLed__PORT EQU 1
o_DebugLed__PRT EQU CYREG_PRT1_PRT
o_DebugLed__PRTDSI__CAPS_SEL EQU CYREG_PRT1_CAPS_SEL
o_DebugLed__PRTDSI__DBL_SYNC_IN EQU CYREG_PRT1_DBL_SYNC_IN
o_DebugLed__PRTDSI__OE_SEL0 EQU CYREG_PRT1_OE_SEL0
o_DebugLed__PRTDSI__OE_SEL1 EQU CYREG_PRT1_OE_SEL1
o_DebugLed__PRTDSI__OUT_SEL0 EQU CYREG_PRT1_OUT_SEL0
o_DebugLed__PRTDSI__OUT_SEL1 EQU CYREG_PRT1_OUT_SEL1
o_DebugLed__PRTDSI__SYNC_OUT EQU CYREG_PRT1_SYNC_OUT
o_DebugLed__PS EQU CYREG_PRT1_PS
o_DebugLed__Red__INTTYPE EQU CYREG_PICU1_INTTYPE4
o_DebugLed__Red__MASK EQU 0x10
o_DebugLed__Red__PC EQU CYREG_PRT1_PC4
o_DebugLed__Red__PORT EQU 1
o_DebugLed__Red__SHIFT EQU 4
o_DebugLed__SHIFT EQU 4
o_DebugLed__SLW EQU CYREG_PRT1_SLW

; Miscellaneous
BCLK__BUS_CLK__HZ EQU 24000000
BCLK__BUS_CLK__KHZ EQU 24000
BCLK__BUS_CLK__MHZ EQU 24
CYDEV_CHIP_DIE_LEOPARD EQU 1
CYDEV_CHIP_DIE_PSOC4A EQU 26
CYDEV_CHIP_DIE_PSOC5LP EQU 2
CYDEV_CHIP_DIE_PSOC5TM EQU 3
CYDEV_CHIP_DIE_TMA4 EQU 4
CYDEV_CHIP_DIE_UNKNOWN EQU 0
CYDEV_CHIP_FAMILY_FM0P EQU 5
CYDEV_CHIP_FAMILY_FM3 EQU 6
CYDEV_CHIP_FAMILY_FM4 EQU 7
CYDEV_CHIP_FAMILY_PSOC3 EQU 1
CYDEV_CHIP_FAMILY_PSOC4 EQU 2
CYDEV_CHIP_FAMILY_PSOC5 EQU 3
CYDEV_CHIP_FAMILY_PSOC6 EQU 4
CYDEV_CHIP_FAMILY_UNKNOWN EQU 0
CYDEV_CHIP_FAMILY_USED EQU CYDEV_CHIP_FAMILY_PSOC5
CYDEV_CHIP_JTAG_ID EQU 0x2E161069
CYDEV_CHIP_MEMBER_3A EQU 1
CYDEV_CHIP_MEMBER_4A EQU 26
CYDEV_CHIP_MEMBER_4AA EQU 25
CYDEV_CHIP_MEMBER_4AB EQU 30
CYDEV_CHIP_MEMBER_4AC EQU 14
CYDEV_CHIP_MEMBER_4AD EQU 15
CYDEV_CHIP_MEMBER_4AE EQU 16
CYDEV_CHIP_MEMBER_4D EQU 20
CYDEV_CHIP_MEMBER_4E EQU 6
CYDEV_CHIP_MEMBER_4F EQU 27
CYDEV_CHIP_MEMBER_4G EQU 4
CYDEV_CHIP_MEMBER_4H EQU 24
CYDEV_CHIP_MEMBER_4I EQU 32
CYDEV_CHIP_MEMBER_4J EQU 21
CYDEV_CHIP_MEMBER_4K EQU 22
CYDEV_CHIP_MEMBER_4L EQU 31
CYDEV_CHIP_MEMBER_4M EQU 29
CYDEV_CHIP_MEMBER_4N EQU 11
CYDEV_CHIP_MEMBER_4O EQU 8
CYDEV_CHIP_MEMBER_4P EQU 28
CYDEV_CHIP_MEMBER_4Q EQU 17
CYDEV_CHIP_MEMBER_4R EQU 9
CYDEV_CHIP_MEMBER_4S EQU 12
CYDEV_CHIP_MEMBER_4T EQU 10
CYDEV_CHIP_MEMBER_4U EQU 5
CYDEV_CHIP_MEMBER_4V EQU 23
CYDEV_CHIP_MEMBER_4W EQU 13
CYDEV_CHIP_MEMBER_4X EQU 7
CYDEV_CHIP_MEMBER_4Y EQU 18
CYDEV_CHIP_MEMBER_4Z EQU 19
CYDEV_CHIP_MEMBER_5A EQU 3
CYDEV_CHIP_MEMBER_5B EQU 2
CYDEV_CHIP_MEMBER_6A EQU 33
CYDEV_CHIP_MEMBER_FM3 EQU 37
CYDEV_CHIP_MEMBER_FM4 EQU 38
CYDEV_CHIP_MEMBER_PDL_FM0P_TYPE1 EQU 34
CYDEV_CHIP_MEMBER_PDL_FM0P_TYPE2 EQU 35
CYDEV_CHIP_MEMBER_PDL_FM0P_TYPE3 EQU 36
CYDEV_CHIP_MEMBER_UNKNOWN EQU 0
CYDEV_CHIP_MEMBER_USED EQU CYDEV_CHIP_MEMBER_5B
CYDEV_CHIP_DIE_EXPECT EQU CYDEV_CHIP_MEMBER_USED
CYDEV_CHIP_DIE_ACTUAL EQU CYDEV_CHIP_DIE_EXPECT
CYDEV_CHIP_REV_LEOPARD_ES1 EQU 0
CYDEV_CHIP_REV_LEOPARD_ES2 EQU 1
CYDEV_CHIP_REV_LEOPARD_ES3 EQU 3
CYDEV_CHIP_REV_LEOPARD_PRODUCTION EQU 3
CYDEV_CHIP_REV_PSOC4A_ES0 EQU 17
CYDEV_CHIP_REV_PSOC4A_PRODUCTION EQU 17
CYDEV_CHIP_REV_PSOC5LP_ES0 EQU 0
CYDEV_CHIP_REV_PSOC5LP_PRODUCTION EQU 0
CYDEV_CHIP_REV_PSOC5TM_ES0 EQU 0
CYDEV_CHIP_REV_PSOC5TM_ES1 EQU 1
CYDEV_CHIP_REV_PSOC5TM_PRODUCTION EQU 1
CYDEV_CHIP_REV_TMA4_ES EQU 17
CYDEV_CHIP_REV_TMA4_ES2 EQU 33
CYDEV_CHIP_REV_TMA4_PRODUCTION EQU 17
CYDEV_CHIP_REVISION_3A_ES1 EQU 0
CYDEV_CHIP_REVISION_3A_ES2 EQU 1
CYDEV_CHIP_REVISION_3A_ES3 EQU 3
CYDEV_CHIP_REVISION_3A_PRODUCTION EQU 3
CYDEV_CHIP_REVISION_4A_ES0 EQU 17
CYDEV_CHIP_REVISION_4A_PRODUCTION EQU 17
CYDEV_CHIP_REVISION_4AA_PRODUCTION EQU 0
CYDEV_CHIP_REVISION_4AB_PRODUCTION EQU 0
CYDEV_CHIP_REVISION_4AC_PRODUCTION EQU 0
CYDEV_CHIP_REVISION_4AD_PRODUCTION EQU 0
CYDEV_CHIP_REVISION_4AE_PRODUCTION EQU 0
CYDEV_CHIP_REVISION_4D_PRODUCTION EQU 0
CYDEV_CHIP_REVISION_4E_CCG2_NO_USBPD EQU 0
CYDEV_CHIP_REVISION_4E_PRODUCTION EQU 0
CYDEV_CHIP_REVISION_4F_PRODUCTION EQU 0
CYDEV_CHIP_REVISION_4F_PRODUCTION_256DMA EQU 0
CYDEV_CHIP_REVISION_4F_PRODUCTION_256K EQU 0
CYDEV_CHIP_REVISION_4G_ES EQU 17
CYDEV_CHIP_REVISION_4G_ES2 EQU 33
CYDEV_CHIP_REVISION_4G_PRODUCTION EQU 17
CYDEV_CHIP_REVISION_4H_PRODUCTION EQU 0
CYDEV_CHIP_REVISION_4I_PRODUCTION EQU 0
CYDEV_CHIP_REVISION_4J_PRODUCTION EQU 0
CYDEV_CHIP_REVISION_4K_PRODUCTION EQU 0
CYDEV_CHIP_REVISION_4L_PRODUCTION EQU 0
CYDEV_CHIP_REVISION_4M_PRODUCTION EQU 0
CYDEV_CHIP_REVISION_4N_PRODUCTION EQU 0
CYDEV_CHIP_REVISION_4O_PRODUCTION EQU 0
CYDEV_CHIP_REVISION_4P_PRODUCTION EQU 0
CYDEV_CHIP_REVISION_4Q_PRODUCTION EQU 0
CYDEV_CHIP_REVISION_4R_PRODUCTION EQU 0
CYDEV_CHIP_REVISION_4S_PRODUCTION EQU 0
CYDEV_CHIP_REVISION_4T_PRODUCTION EQU 0
CYDEV_CHIP_REVISION_4U_PRODUCTION EQU 0
CYDEV_CHIP_REVISION_4V_PRODUCTION EQU 0
CYDEV_CHIP_REVISION_4W_PRODUCTION EQU 0
CYDEV_CHIP_REVISION_4X_PRODUCTION EQU 0
CYDEV_CHIP_REVISION_4Y_PRODUCTION EQU 0
CYDEV_CHIP_REVISION_4Z_PRODUCTION EQU 0
CYDEV_CHIP_REVISION_5A_ES0 EQU 0
CYDEV_CHIP_REVISION_5A_ES1 EQU 1
CYDEV_CHIP_REVISION_5A_PRODUCTION EQU 1
CYDEV_CHIP_REVISION_5B_ES0 EQU 0
CYDEV_CHIP_REVISION_5B_PRODUCTION EQU 0
CYDEV_CHIP_REVISION_6A_ES EQU 17
CYDEV_CHIP_REVISION_6A_NO_UDB EQU 33
CYDEV_CHIP_REVISION_6A_PRODUCTION EQU 33
CYDEV_CHIP_REVISION_FM3_PRODUCTION EQU 0
CYDEV_CHIP_REVISION_FM4_PRODUCTION EQU 0
CYDEV_CHIP_REVISION_PDL_FM0P_TYPE1_PRODUCTION EQU 0
CYDEV_CHIP_REVISION_PDL_FM0P_TYPE2_PRODUCTION EQU 0
CYDEV_CHIP_REVISION_PDL_FM0P_TYPE3_PRODUCTION EQU 0
CYDEV_CHIP_REVISION_USED EQU CYDEV_CHIP_REVISION_5B_PRODUCTION
CYDEV_CHIP_REV_EXPECT EQU CYDEV_CHIP_REVISION_USED
CYDEV_CONFIG_FASTBOOT_ENABLED EQU 1
CYDEV_CONFIG_UNUSED_IO_AllowButWarn EQU 0
CYDEV_CONFIG_UNUSED_IO EQU CYDEV_CONFIG_UNUSED_IO_AllowButWarn
CYDEV_CONFIG_UNUSED_IO_AllowWithInfo EQU 1
CYDEV_CONFIG_UNUSED_IO_Disallowed EQU 2
CYDEV_CONFIGURATION_COMPRESSED EQU 1
CYDEV_CONFIGURATION_DMA EQU 0
CYDEV_CONFIGURATION_ECC EQU 1
CYDEV_CONFIGURATION_IMOENABLED EQU CYDEV_CONFIG_FASTBOOT_ENABLED
CYDEV_CONFIGURATION_MODE_COMPRESSED EQU 0
CYDEV_CONFIGURATION_MODE EQU CYDEV_CONFIGURATION_MODE_COMPRESSED
CYDEV_CONFIGURATION_MODE_DMA EQU 2
CYDEV_CONFIGURATION_MODE_UNCOMPRESSED EQU 1
CYDEV_DEBUG_ENABLE_MASK EQU 0x20
CYDEV_DEBUG_ENABLE_REGISTER EQU CYREG_MLOGIC_DEBUG
CYDEV_DEBUGGING_DPS_Disable EQU 3
CYDEV_DEBUGGING_DPS_JTAG_4 EQU 1
CYDEV_DEBUGGING_DPS_JTAG_5 EQU 0
CYDEV_DEBUGGING_DPS_SWD EQU 2
CYDEV_DEBUGGING_DPS_SWD_SWV EQU 6
CYDEV_DEBUGGING_DPS EQU CYDEV_DEBUGGING_DPS_SWD_SWV
CYDEV_DEBUGGING_ENABLE EQU 1
CYDEV_DEBUGGING_XRES EQU 0
CYDEV_DMA_CHANNELS_AVAILABLE EQU 24
CYDEV_ECC_ENABLE EQU 0
CYDEV_HEAP_SIZE EQU 0x80
CYDEV_INSTRUCT_CACHE_ENABLED EQU 1
CYDEV_INTR_RISING EQU 0x00000001
CYDEV_IS_EXPORTING_CODE EQU 0
CYDEV_IS_IMPORTING_CODE EQU 0
CYDEV_PROJ_TYPE EQU 0
CYDEV_PROJ_TYPE_BOOTLOADER EQU 1
CYDEV_PROJ_TYPE_LAUNCHER EQU 5
CYDEV_PROJ_TYPE_LOADABLE EQU 2
CYDEV_PROJ_TYPE_LOADABLEANDBOOTLOADER EQU 4
CYDEV_PROJ_TYPE_MULTIAPPBOOTLOADER EQU 3
CYDEV_PROJ_TYPE_STANDARD EQU 0
CYDEV_PROTECTION_ENABLE EQU 0
CYDEV_STACK_SIZE EQU 0x0800
CYDEV_USE_BUNDLED_CMSIS EQU 1
CYDEV_VARIABLE_VDDA EQU 0
CYDEV_VDDA_MV EQU 5000
CYDEV_VDDD_MV EQU 5000
CYDEV_VDDIO0_MV EQU 5000
CYDEV_VDDIO1_MV EQU 5000
CYDEV_VDDIO2_MV EQU 5000
CYDEV_VDDIO3_MV EQU 5000
CYDEV_VIO0_MV EQU 5000
CYDEV_VIO1_MV EQU 5000
CYDEV_VIO2_MV EQU 5000
CYDEV_VIO3_MV EQU 5000
CYIPBLOCK_ARM_CM3_VERSION EQU 0
CYIPBLOCK_P3_ANAIF_VERSION EQU 0
CYIPBLOCK_P3_CAN_VERSION EQU 0
CYIPBLOCK_P3_CAPSENSE_VERSION EQU 0
CYIPBLOCK_P3_COMP_VERSION EQU 0
CYIPBLOCK_P3_DECIMATOR_VERSION EQU 0
CYIPBLOCK_P3_DFB_VERSION EQU 0
CYIPBLOCK_P3_DMA_VERSION EQU 0
CYIPBLOCK_P3_DRQ_VERSION EQU 0
CYIPBLOCK_P3_DSM_VERSION EQU 0
CYIPBLOCK_P3_EMIF_VERSION EQU 0
CYIPBLOCK_P3_I2C_VERSION EQU 0
CYIPBLOCK_P3_LCD_VERSION EQU 0
CYIPBLOCK_P3_LPF_VERSION EQU 0
CYIPBLOCK_P3_OPAMP_VERSION EQU 0
CYIPBLOCK_P3_PM_VERSION EQU 0
CYIPBLOCK_P3_SCCT_VERSION EQU 0
CYIPBLOCK_P3_TIMER_VERSION EQU 0
CYIPBLOCK_P3_USB_VERSION EQU 0
CYIPBLOCK_P3_VIDAC_VERSION EQU 0
CYIPBLOCK_P3_VREF_VERSION EQU 0
CYIPBLOCK_S8_GPIO_VERSION EQU 0
CYIPBLOCK_S8_IRQ_VERSION EQU 0
CYIPBLOCK_S8_SAR_VERSION EQU 0
CYIPBLOCK_S8_SIO_VERSION EQU 0
CYIPBLOCK_S8_UDB_VERSION EQU 0
DMA_CHANNELS_USED__MASK0 EQU 0x00000000
CYDEV_BOOTLOADER_ENABLE EQU 0
    ENDIF
    END
